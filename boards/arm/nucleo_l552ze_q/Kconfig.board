## boards/arm/nucleo_l552ze_q/Kconfig.board
```kconfig
# STM32L552ZE Q Nucleo board configuration

# Copyright (c) 2020 Linaro Limited
# SPDX-License-Identifier: Apache-2.0

config BOARD_NUCLEO_L552ZE_Q
	bool "Nucleo L552ZE Q Development Board"
	depends on SOC_STM32L552XX

if BOARD_NUCLEO_L552ZE_Q

DT_COMPAT_NORDIC_NRF700X_QSPI := nordic,nrf700x-qspi
DT_COMPAT_NORDIC_NRF700X_SPI := nordic,nrf700x-spi

config NRF7002_ON_QSPI
	def_bool $(dt_compat_enabled,$(DT_COMPAT_NORDIC_NRF700X_QSPI))

config NRF7002_ON_SPI
	def_bool $(dt_compat_enabled,$(DT_COMPAT_NORDIC_NRF700X_SPI))

endif # BOARD_NUCLEO_L552ZE_Q
```

## boards/arm/nucleo_u575zi_q/Kconfig.board
```kconfig
# STM32U575ZI Q Nucleo board configuration

# Copyright (c) 2021 Linaro Limited
# SPDX-License-Identifier: Apache-2.0

config BOARD_NUCLEO_U575ZI_Q
	bool "Nucleo U575ZI Q Development Board"
	depends on SOC_STM32U575XX

if BOARD_NUCLEO_U575ZI_Q

DT_COMPAT_NORDIC_NRF700X_QSPI := nordic,nrf700x-qspi
DT_COMPAT_NORDIC_NRF700X_SPI := nordic,nrf700x-spi

config NRF7002_ON_QSPI
	def_bool $(dt_compat_enabled,$(DT_COMPAT_NORDIC_NRF700X_QSPI))

config NRF7002_ON_SPI
	def_bool $(dt_compat_enabled,$(DT_COMPAT_NORDIC_NRF700X_SPI))

endif # BOARD_NUCLEO_U575ZI_Q
```

## drivers/memc/Kconfig.numaker
```kconfig
# Copyright (c) 2023 iWorx Systems Inc.
# SPDX-License-Identifier: Apache-2.0

config MEMC_NUVOTON_NUMAKER_HYPERBUS
	bool "Hyperbus for Nuvoton's m46x series microcontrollers"
	default y
    select HAS_NUVOTON_NUMAKER_HYPERBUS
#	depends on DT_HAS_NUVOTON_NUMAKER_HYPERBUS_ENABLED
	help
	  Enable Hyperbus on m46x series Nuvoton microcontrollers
```

## drivers/sram/Kconfig
```kconfig
# SRAM driver configuration options

# Copyright (c) 2023 iWorx Systems
# SPDX-License-Identifier: Apache-2.0

#
# SRAM Drivers
#
menuconfig SRAM
	bool "Serial Peripheral Interface (SPI) bus drivers"
	help
	  Enable support for the SPI hardware bus.

if SRAM

module = SRAM
module-str = sram
source "subsys/logging/Kconfig.template.log_config"

endif # SRAM
```

## drivers/sram/Kconfig.spi
```kconfig
# Driver for SRAM on SPI bus.
#
# Copyright (c) 2023 iWorx Systems
#
# SPDX-License-Identifier: Apache-2.0
#

config SRAM_SPI
	bool "SRAM on SPI bus driver"
	default y
	select SPI
	help
	  Enable driver for SRAM on SPI bus.
```

## dts/bindings/memory-controllers/nuvoton,numaker-hyperbus.yaml
```yaml
description: Nuvoton NuMaker Hyperbus Controller

compatible: "nuvoton,numaker-hyperbus"

include: [base.yaml, reset-device.yaml]

properties:
  reg:
    required: true

  interrupts:
    required: true

  resets:
    required: true
    
  "#address-cells":
    required: true
    const: 1

  "#size-cells":
    required: true
    const: 1
```

## dts/bindings/mtd/issi,is6xwvo32m8dxll-octalram.yaml
```yaml
# Copyright (c) 2023 iWorx Systems
# SPDX-License-Identifier: Apache-2.0

description: |
  Binding for ISSI's IS66/67WVO32M8DALL/BLL octal SRAM.
  For info on hyperbus specification refer to Cypress's 
  document number: 001-99253.

compatible: issi,is6xwvo32m8dxll-octalram

include: base.yaml

properties:
  reg:
    required: true

  drive-strength:
    type: string
    enum:
      - "146_ohms"
      - "76_ohms"
      - "52_ohms"
      - "41_ohms"
      - "34_ohms"
      - "30_ohms"
      - "26_ohms"
      - "24_ohms"
    description: "Pin driver output impedance."
  
  dqsm-read-precycle:
    type: string
    enum:
      - "0_clock"
      - "1_clock"
    description: "DQSM is Refresh Collision Indicator, Data Strobe Signal in Read operation, and Write Data Mask in Write operation."

  initial-latency:
    type: string
    enum:
      - "3_clocks"
      - "4_clocks"
      - "5_clocks"
      - "6_clocks"
      - "7_clocks"
      - "8_clocks"
    description: "This sets the inital latency for read/write transactions."

  fixed-latency-enable:
    type: boolean
    description: "Set true for fixed initial latency and false for variable initial latency."

  burst-length:
    type: string
    enum:
      - "128_bytes"
      - "64_bytes"
      - "32_bytes"
      - "16_bytes"
```

## dts/bindings/mtd/winbond,w956x8mbya5i-octalram.yaml
```yaml
# Copyright (c) 2023 iWorx Systems
# SPDX-License-Identifier: Apache-2.0

description: |
  Binding for Winbonds's W956(D/A)8MBYA octal SRAM.
  For info on hyperbus specification refer to Cypress's 
  document number: 001-99253.

compatible: winbond,w956x8mbya5i-octalram

include: base.yaml

properties:
  drive-strength-ohms:
    type: int
    enum:
      - 34
      - 115
      - 67
      - 46
      - 34
      - 27
      - 22
      - 19
    default: 34
    description: Pin driver output impedance.

  initial-latency-clks:
    type: int
    enum:
      - 5
      - 6
      - 7
      - 3
      - 4
    default: 7
    description: |
      This sets the inital latency for read/write
      transactions.

  fixed-latency-enable:
    type: int
    enum:
      - 0
      - 1
    default: 1
    description: |
      Set true for fixed 2x initial latency and false for
      variable initial latency (either x1 or x2).

  hybrid-burst-enable:
    type: int
    enum:
      - 0
      - 1
    default: 1
    description: |
      Set true to handle wrapped burst sequences in
      legacy mode and flase to handle them with hybrid
      burst sequencing.

  burst-byte-length:
    type: int
    enum:
      - 128
      - 64
      - 16
      - 32
    default: 32
    description: Num bytes to read/write per burst.
```

## dts/bindings/sram/spi-sram.yaml
```yaml
# Copyright (c) 2023 iWorx Systems
# SPDX-License-Identifier: Apache-2.0

description: |
  Driver binding for external SRAM on SPI bus.

compatible: "spi-sram"

include: [spi-device.yaml]

properties:
  reg:
    required: true

  size:
    type: int
    description: |
      The size in bits. Set this or size-in-bytes, but not both.
```
